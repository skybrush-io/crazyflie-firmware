## app/Kconfig
```kconfig
menu "Skybrush app configuration"

choice
    prompt "Positioning system"
    default SHOW_POSITIONING_UWB

    config SHOW_POSITIONING_UWB
        bool "UWB"

    config SHOW_POSITIONING_LIGHTHOUSE
        bool "Lighthouse"

    config SHOW_POSITIONING_ACTIVE_MARKER
        bool "Active markers"

endchoice

menu "Preflight checks"

config PREFLIGHT_ENABLE_BATTERY_VOLTAGE_CHECK
    bool "Check the battery voltage"
    default y

config PREFLIGHT_MIN_BATTERY_VOLTAGE
    int "Minimum battery voltage, in 1/10 volts"
    default 38
    depends on PREFLIGHT_ENABLE_BATTERY_VOLTAGE_CHECK

config PREFLIGHT_ENABLE_TRAJECTORY_CHECK
    bool "Check the uploaded number of trajectories and light programs"
    default y

config PREFLIGHT_MIN_TRAJECTORIES
    int "Minimum number of trajectories"
    default 1
    depends on PREFLIGHT_ENABLE_TRAJECTORY_CHECK
    range 0 8

config PREFLIGHT_MIN_LIGHT_PROGRAMS
    int "Minimum number of light programs"
    default 1
    depends on PREFLIGHT_ENABLE_TRAJECTORY_CHECK
    range 0 8

config PREFLIGHT_ENABLE_POSITIONING_CHECK
    bool "Check the positioning system"
    default y

config PREFLIGHT_MIN_LOCO_ANCHOR_COUNT
    int "Minimum number of UWB (Loco) anchors"
    depends on SHOW_POSITIONING_UWB && PREFLIGHT_ENABLE_POSITIONING_CHECK
    default 6
    range 1 8
    help
        Minimum number of UWB (Loco) anchors for which the drone needs to have
        position information before takeoff.

config PREFLIGHT_MIN_ACTIVE_LOCO_ANCHOR_COUNT
    int "Minimum number of active UWB (Loco) anchors"
    depends on SHOW_POSITIONING_UWB && PREFLIGHT_ENABLE_POSITIONING_CHECK
    default 6
    range 1 8
    help
        Minimum number of UWB (Loco) anchors that the drone needs to consider
        as actively transmitting before takeoff.

config PREFLIGHT_MIN_LH_BS_COUNT
    int "Minimum number of Lighthouse base stations"
    depends on SHOW_POSITIONING_LIGHTHOUSE && PREFLIGHT_ENABLE_POSITIONING_CHECK
    default 2
    range 1 8
    help
        Minimum number of Lighthouse base stations for which the drone needs to
        have geometry information before takeoff.

config PREFLIGHT_MIN_ACTIVE_LH_BS_COUNT
    int "Minimum number of active Lighthouse base stations"
    depends on SHOW_POSITIONING_LIGHTHOUSE && PREFLIGHT_ENABLE_POSITIONING_CHECK
    default 1
    range 1 8
    help
        Minimum number of Lighthouse base stations from which the drone must be
        receiving light beams before takeoff.

config PREFLIGHT_ENABLE_HOME_POSITION_CHECK
    bool "Check the home position"
    default y

config PREFLIGHT_MAX_HOME_POSITION_DISTANCE_XY_CM
    int "Maximum home position distance in XY plane, in centimeters"
    depends on PREFLIGHT_ENABLE_HOME_POSITION_CHECK
    default 50
    range 0 200

config PREFLIGHT_MAX_HOME_POSITION_DISTANCE_Z_CM
    int "Maximum home position distance in Z axis, in centimeters"
    depends on PREFLIGHT_ENABLE_HOME_POSITION_CHECK
    default 50
    range 0 200

endmenu

config SHOW_TAKEOFF_HEIGHT_CM
    int "Takeoff height, in centimeters"
    default 100
    help
        Altitude that the drone should take off to at the start of the show,
        assuming that the ground is at Z=0.

menu "Custom hacks"

config SHOW_SMOOTH_TAKEOFF
    bool "Use smooth takeoff"
    default n
    help
        Use a longer duration for the takeoff. This should be enabled for
        larger builds with stronger motors to make the takeoff less scary.
        It should be off for the stock drone with UWB as we want to get
        away from the ground as fast as possible with UWB.

config SHOW_MODE_SILENT
    bool "Disable console messages during show mode"
    default y
    help
        Prevents the drone from sending console messages related to the show
        subsystem of the firmware.

config SHOW_STEALTH_MODE
    bool "Turn off onboard status LEDs"
    default n
    help
        Turn off the onboard status LEDs to make the drone completely dark
        apart from the LED deck

config SHOW_TDOA_LARGE_AREA
    bool "Assume a larger area and larger stddev for TDoA measurements"
    default n
    help
        Increase the standard deviation of TDoA measurements for large areas,
        especially when using the "long range" TDoA mode

endmenu

endmenu
```
